## apps/examples/iotivity_constrained_simpleclient/Kconfig
```kconfig
#
# For a description of the syntax of this configuration file,
# see kconfig-language at https://www.kernel.org/doc/Documentation/kbuild/kconfig-language.txt
#

config EXAMPLES_IOTIVITY_CONSTRAINED_SIMPLECLIENT
	bool "Enable building IoTivity Constrained Simple Client Sample"
	default n
	depends on ENABLE_IOTIVITY_CONSTRAINED
	---help---
		Enable building IoTivity Constrained Simple Client Samples
```

## apps/examples/iotivity_constrained_simpleserver/Kconfig
```kconfig
#
# For a description of the syntax of this configuration file,
# see kconfig-language at https://www.kernel.org/doc/Documentation/kbuild/kconfig-language.txt
#

config EXAMPLES_IOTIVITY_CONSTRAINED_SIMPLESERVER
	bool "Enable building IoTivity Constrained Simple Server Samples"
	default n
	depends on ENABLE_IOTIVITY_CONSTRAINED
	---help---
		Enable building IoTivity Constrained Simple Server Samples
```

## apps/examples/stm32l4_demo/Kconfig
```kconfig
#
# For a description of the syntax of this configuration file,
# see kconfig-language at https://www.kernel.org/doc/Documentation/kbuild/kconfig-language.txt
#

config EXAMPLES_STM32L4_DEMO
	bool "stm32l4 demo example"
	default n
	depends on ARCH_BOARD_STM32L4
	---help---
		Enable the stm32l4 demo example
```

## apps/examples/stm32l4xr_demo/Kconfig
```kconfig
#
# For a description of the syntax of this configuration file,
# see kconfig-language at https://www.kernel.org/doc/Documentation/kbuild/kconfig-language.txt
#

config EXAMPLES_STM32L4XR_DEMO
	bool "stm32l4xr board demo"
	default n
	depends on ARCH_BOARD_STM32L4XR
	---help---
		Enable the stm32l4xr board demo example
```

## external/iotivity-constrained/Kconfig
```kconfig
#
# For a description of the syntax of this configuration file,
# see kconfig-language at https://www.kernel.org/doc/Documentation/kbuild/kconfig-language.txt
#

menuconfig ENABLE_IOTIVITY_CONSTRAINED
	bool "enable / disable iotivity constrained stack"
	default n
	select NET_LWIP_NETDB
	select TIME_EXTENDED
	select ARCH_STDARG_H
	---help---
		select to enable the iotivity constrained stack in tinyara

if ENABLE_IOTIVITY_CONSTRAINED

comment "IOTIVITY CONSTRAINED Config Parameters"

config IOTIVITY_CONSTRAINED_RELEASE_VERSION
	string "iotivity constrained stack version"
	default "GETTING STARTED"
	---help---
		define this to iotivity constrained stack release veriosn in use

config IOTIVITY_CONSTRAINED_SERVER
	bool "enable an iotivity constrained sever role"
	default y
	---help---
		select to enable an iotivity constrained server role

config IOTIVITY_CONSTRAINED_CLIENT
	bool "enable an iotivity constrained client role"
	default n
	---help---
		select to enable an iotivity constrained client role

config IOTIVITY_CONSTRAINED_SECURED
	bool "enable iotivity constrained security"
	default n
	select NET_SECURITY_TLS
	---help---
		select to enable the security for iotivity constrained stack in tinyara

config IOTIVITY_CONSTRAINED_DEBUG
    bool "enable debug mode build"
    default n
    ---help---
        select to enable a debug mode build with verbose debug output

config IOTIVITY_CONSTRAINED_TCP
    bool "enable iotivity constrained TCP support"
    default n
    ---help---
        select to enable iotivity constrained to support for TCP endpoints and CoAP over TCP (RFC 8323)

config IOTIVITY_CONSTRAINED_IPV4
    bool "enable iotivity constrained IPV4"
    default y
    ---help---
        select to enable iotivity constrained to support for IPV4

config IOTIVITY_CONSTRAINED_IPV6
    bool "enable iotivity constrained IPV6"
    default n
    ---help---
        select to enable iotivity constrained to support for IPV6

endif # ENABLE_IOTIVITY_CONSTRAINED
```

## os/arch/arm/src/stm32l4x3/Kconfig
```kconfig
#
# For a description of the syntax of this configuration file,
# see the file kconfig-language.txt in the NuttX tools repository.
#

if ARCH_BOARD_STM32L4x3

config STM32L4X3_BUTTON
	bool "Enable STM32L4x3 user button"
	default y
	---help---
		Enables user button test on Nucleo board with low level GPIO EINT

endif # ARCH_BOARD_STM32L4x3
```

## os/arch/arm/src/stm32l4xr/Kconfig
```kconfig
#
# For a description of the syntax of this configuration file,
# see the file kconfig-language.txt in the NuttX tools repository.
#

if ARCH_BOARD_STM32L4XR

config STM32L4X3_BUTTON
	bool "Enable STM32L4x3 user button"
	default y
	---help---
		Enables user button test on Nucleo board with low level GPIO EINT

config STM32L4XR_FLASH_CAPACITY
	int "Size of external flash memory (in bytes)"
	default 2097152
	---help---
		Sets the capacity of the external flash memory
		on the ARTIK-05x Series Starter Kit board.

config STM32L4XR_FLASH_PAGE_SIZE
	int "Page size of external flash memory (in bytes)"
	default 4096
	---help---
		Sets the page size of the external flash memory on the
		ARTIK-05x Series Starter Kit board. It can be the size of erase
		unit flash memory supports.

config STM32L4XR_FLASH_PART
	bool "Enable partition support on FLASH"
	default n
	select MTD
	select MTD_PARTITION
	select MTD_PROGMEM
	depends on NFILE_DESCRIPTORS != 0
	---help---
		Enables creation of partitions on the FLASH

config STM32L4XR_FLASH_MINOR
	int "Minor number for the FLASH device"
	default 0
	depends on STM32L4XR_FLASH_PART
	---help---
		Sets the minor number for /dev node of the external flash
		device.

config STM32L4XR_FLASH_PART_LIST
	string "Flash partition size list (in KBytes)"
	default "1400,64,128,128,8,64,"
	depends on STM32L4XR_FLASH_PART
	---help---
		Comma separated list of partition sizes in KB.

config STM32L4XR_FLASH_PART_TYPE
	string "Flash partition type list"
	default "none,none,smartfs,romfs,config,none,"
	depends on STM32L4XR_FLASH_PART
	---help---
		Comma separated list of partition types that can be one of
		followings: none, smartfs, config

config STM32L4XR_FLASH_PART_NAME
	string "Flash partition name list"
	default "os,factory,user,rom,nvram,sssrw,"
	depends on MTD_PARTITION_NAMES
	depends on STM32L4XR_FLASH_PART
	---help---
		Comma separated list of partition names.

config STM32L4XR_AUTOMOUNT
	bool "Automount partitions"
	default n
	depends on STM32L4XR_FLASH_PART
	depends on !DISABLE_MOUNTPOINT
	---help---
		If enabled, mount userrw and sssrw partitions at boot.

config STM32L4XR_AUTOMOUNT_USERFS
	bool "Automount user r/w partiton"
	default n
	depends on STM32L4XR_AUTOMOUNT
	depends on FS_SMARTFS
	---help---
		If enabled, user r/w partition will be mounted automatically
		at boot.

config STM32L4XR_AUTOMOUNT_USERFS_DEVNAME
	string "Device name of the partition for user r/w file system"
	default "/dev/smart0p2"
	depends on STM32L4XR_AUTOMOUNT_USERFS
	---help---
		Specifies the device name (/dev/smart0pX) of the partition
		for user r/w file system.
		when SMARTFS_MULTI_ROOT_DIRS is enabled the device name
		will be appended by "d1" (/dev/smart0pxd1).

config STM32L4XR_AUTOMOUNT_USERFS_MOUNTPOINT
	string "Mountpoint of the partition for user r/w file system"
	default "/mnt"
	depends on STM32L4XR_AUTOMOUNT_USERFS
	---help---
		Specifies the mount point where user r/w file system
		will be mounted at.

config STM32L4XR_AUTOMOUNT_SSSRW
	bool "Automount secure storage partiton"
	default n
	depends on STM32L4XR_AUTOMOUNT
	---help---
		If enabled, secure storage partition will be mounted
		automatically at boot.

config STM32L4XR_AUTOMOUNT_SSSRW_DEVNAME
	string "Device name of the partition for secure storage"
	default "/dev/smart0p5"
	depends on STM32L4XR_AUTOMOUNT_SSSRW
	---help---
		Specifies the device name (/dev/smart0pX) of the partition
		for secure storage.

config STM32L4XR_AUTOMOUNT_SSSRW_MOUNTPOINT
	string "Mountpoint of the partition for secure storage"
	default "/sss"
	depends on STM32L4XR_AUTOMOUNT_SSSRW
	---help---
		Specifies the mount point where secure storage
		will be mounted at.

config STM32L4XR_AUTOMOUNT_ROMFS
	bool "Automount romfs partiton"
	default y
	depends on STM32L4XR_AUTOMOUNT
	depends on FS_ROMFS
	---help---
		If enabled, romfs partition will be mounted automatically
		at boot.

config STM32L4XR_AUTOMOUNT_ROMFS_DEVNAME
	string "Device name of the partition for romfs file system"
	default "/dev/mtdblock3"
	depends on STM32L4XR_AUTOMOUNT_ROMFS
	---help---
		Specifies the device name (/dev/mtdblock3) of the partition
		for romfs file system.

config STM32L4XR_AUTOMOUNT_ROMFS_MOUNTPOINT
	string "Mountpoint of the partition for romfs file system"
	default "/rom"
	depends on STM32L4XR_AUTOMOUNT_ROMFS
	---help---
		Specifies the mount point where romfs file system
		will be mounted at.

if RAMMTD
config STM32L4XR_RAMMTD_NEBLOCKS
	int "RAM MTD erase block count"
	default 64
	---help---
		Ramfs size will be RAMMTD_ERASESIZE * STM32L4XR_RAMMTD_NEBLOCKS.
		You have to consider total ramsize to alloc ramfs size.

config STM32L4XR_RAMMTD_DEV_NUMBER
	int "device number for mtd of smartfs"
	default 3

config STM32L4XR_RAMMTD_DEV_POINT
	string "Device name of the partition for ramfs r/w file system"
	default "/dev/smart5"

config STM32L4XR_RAMMTD_MOUNT_POINT
	string "Mountpoint of the partition for ramfs r/w file system"
	default "/ramfs"
endif

endif # ARCH_BOARD_STM32L4x3
```

## os/drivers/wireless/Kconfig
```kconfig
#
# For a description of the syntax of this configuration file,
# see kconfig-language at https://www.kernel.org/doc/Documentation/kbuild/kconfig-language.txt
#

if DRIVERS_WIRELESS

	if ARCH_CHIP_STM32L4
		source drivers/wireless/brcm/Kconfig
	endif

	if ARCH_CHIP_S5J
		source drivers/wireless/scsc/Kconfig
	endif

endif # DRIVERS_WIRELESS
```

## os/drivers/wireless/brcm/Kconfig
```kconfig
config BRCM_WLAN
	bool "Broadcom Wireless Module support"
	depends on LIBM && SCHED_WORKQUEUE && !DISABLE_PTHREAD && WPA_SUPPLICANT && ARCH_CHIP_STM32L4
	default n
```
